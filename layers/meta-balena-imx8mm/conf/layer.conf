## layers/meta-balena-imx8mm/conf/layer.conf
```bitbake
BBPATH .= ":${LAYERDIR}"

BBFILES += "${LAYERDIR}/recipes-*/*/*.bb \
            ${LAYERDIR}/recipes-*/*/*.bbappend"

BBFILE_COLLECTIONS += "balena-iot-gate-imx8"
BBFILE_PATTERN_balena-iot-gate-imx8 := "^${LAYERDIR}/"
BBFILE_PRIORITY_balena-iot-gate-imx8 = "1337"
LAYERSERIES_COMPAT_balena-iot-gate-imx8 = "zeus dunfell"

LAYERSERIES_COMPAT_balena-common_append = " zeus"
LAYERSERIES_COMPAT_balena-dunfell_append = " zeus"

#SERIAL_CONSOLES_cl-som-imx8 = "115200;ttymxc2"

LAYERSERIES_COMPAT_fsl-bsp-release_append = " dunfell"
LAYERSERIES_COMPAT_meta-ml_append = " dunfell"
LAYERSERIES_COMPAT_fsl-sdk-release_append = " dunfell"
LAYERSERIES_COMPAT_compulab-utils_append = " dunfell"

BBMASK += "compulab-ucm-imx8m-mini.bb"
BBMASK += "bt-start_%.bbappend"
BBMASK += "u-boot-imx-fw-utils_2019.04.bbappend"
BBMASK += "optee-imx"
BBMASK += "gstreamer*"
BBMASK += "weston*"
BBMASK += "wayland*"
BBMASK += "kernel-module-imx-gpu-viv_6.4.0.p2.4*"
BBMASK += "imx-gpu-g2d_6.4.0.p2.4*"
BBMASK += "xf86-video-imx-vivante_6.4.0.p0.0*"
BBMASK += "imx-dpu-g2d_1.8.7*"
BBMASK += "libdrm_2.4.99.imx*"
BBMASK += "u-boot-imx-fw-utils_2019.04*"
BBMASK += "compulab-qt5-build-env*"


BBMASK += "chromium_%.bbappend"
BBMASK += "u-boot-fw-utils_%.bbappend"
BBMASK += "nfs-utils_2.4.1.bbappend"
BBMASK += "sysvinit_2.88dsf.bbappend"
BBMASK += "assimp_4.1.0.bbappend"
BBMASK += "pulseaudio_12.2.bbappend"
BBMASK += "fsl-rc-local.bbappend"
BBMASK += "fsl-image-machine-test.bbappend"
BBMASK += "fsl-image-multimedia.bbappend"
BBMASK += "packagegroup-fsl-tools-gpu.bbappend"
BBMASK += "packagegroup-fsl-tools-testapps.bbappend"

BBMASK += "meta-imx/meta-bsp/recipes-kernel/linux/linux-imx_5.4.bb"
BBMASK += "dvb-apps_%.bbappend"
BBMASK += "wxwidgets_git.bb"

BBMASK += "meta-imx/meta-bsp/recipes-bsp/u-boot/*"
BBMASK += "meta-freescale/recipes-bsp/u-boot/u-boot-imx_2020.04.bb"

BBMASK += "python-erpc_git.bb"
BBMASK += "kernel-module-pcie8997.bb"
BBMASK += "python-pycrypto_2.6.1.bb"

PREFERRED_PROVIDER_virtual/kernel_iot-gate-imx8 = "linux-imx"
PREFERRED_VERSION_virtual/kernel_iot-gate-imx8 = "5.4%"

PREFERRED_PROVIDER_virtual/bootloader_iot-gate-imx8 = "u-boot-imx"
PREFERRED_VERSION_virtual/bootloader_iot-gate-imx8 = "2020.04%"
PREFERRED_RPROVIDER_u-boot-fw-utils = "u-boot-imx-fw-utils"

PREFERRED_PROVIDER_u-boot-tools = "u-boot-imx-tools"

CORE_IMAGE_EXTRA_INSTALL_remove = "firmware-imx-sdma-imx7d"
CORE_IMAGE_EXTRA_INSTALL_append = " cl-uboot cl-deploy u-boot-imx-tools"

MACHINE_FEATURES_remove = "mrvl8997"
MACHINE_FEATURES_remove = "touchscreen"
MACHINE_FEATURES_remove = "optee"

PLATFORM_FLAVOR_iot-gate-imx8 = "mx8mmevk"
```
